## images/buildroot/packages/sedutil/Config.in
```kconfig
config BR2_PACKAGE_SEDUTIL
        bool "sedutil"
	depends on BR2_INSTALL_LIBSTDCPP
        help
          This package provides support for Self Encrypting Drives (SEDs)

          https://github.com/ladar/sedutil

comment "sedutil needs a toolchain w/ C++"
	depends on !BR2_INSTALL_LIBSTDCPP
```
